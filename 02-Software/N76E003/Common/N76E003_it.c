/**
  ******************************************************************************
  * @file    
  * @author  
  * @version 
  * @date    
  * @brief   
  * ******************************************************************************
  */ 

/* Includes ------------------------------------------------------------------*/
#include "N76E003_it.h"
#include "timer_counter.h"
#include "inc.h"

#ifdef DIMMING
#else
#include "transport.h"
#endif
/** @addtogroup Template_Project
  * @{
  */

/* Private typedef -----------------------------------------------------------*/
/* Private define ------------------------------------------------------------*/
/* Private macro -------------------------------------------------------------*/
/* Private variables ---------------------------------------------------------*/
/* Private function prototypes -----------------------------------------------*/
/* Private functions ---------------------------------------------------------*/
/* Public functions ----------------------------------------------------------*/
    
/************************************************************************************************************
*    External 0 interrupt subroutine
************************************************************************************************************/
#pragma vector=0x03
__interrupt void External0_ISR (void){
  
}

/************************************************************************************************************
*    TIMER 0 interrupt subroutine
************************************************************************************************************/
#pragma vector=0x0B
__interrupt void Timer0_ISR (void)
{
  
}
/************************************************************************************************************
*    External 1 interrupt subroutine
************************************************************************************************************/
#pragma vector=0x13
__interrupt void External1_ISR (void)
{
  
}
/************************************************************************************************************
*    TIMER 1 interrupt subroutine
************************************************************************************************************/
#pragma vector=0x1B
__interrupt void Timer1_ISR (void)
{
  
}

/************************************************************************************************************
*    Serial 0 interrupt subroutine
************************************************************************************************************/
#pragma vector=0x23
__interrupt void UART0_ISR (void)
{
#if defined (DIMMING)
   
#else
  if( SET == UART0_GetITStatus(UART0_TI) )
  {
    uint8_t data, ret;
    ret = Transport_TxPop(&data);
    if( ret == SUCCESS ) {
      Transport_OutputEnable();
      UART0_SendData8(data);
    } else {
      Transport_OutputDisable();
    }
    //Clear IT Flag
    UART0_ClearITStatus(UART0_TI);
  } 
  if( SET == UART0_GetITStatus(UART0_RI)) {\
    uint8_t data = UART0_ReceiveData8();
    Transport_RxPush(data);
    //Clear Interrupt Flag
    UART0_ClearITStatus(UART0_RI);
  }
#endif
}

/************************************************************************************************************
*    TIMER 2 Event interrupt subroutine
************************************************************************************************************/
#pragma vector=0x2B
__interrupt void Timer2_ISR (void)
{
  
}

/************************************************************************************************************
*    I2C interrupt subroutine
************************************************************************************************************/
#pragma vector=0x33
__interrupt void I2C_ISR (void)
{
  
}

/************************************************************************************************************
*    Pin interrupt subroutine
************************************************************************************************************/
#pragma vector=0x3B
__interrupt void Pin_ISR (void)
{
  
}

/************************************************************************************************************
*    Brown-out interrupt subroutine
************************************************************************************************************/
#pragma vector=0x43
__interrupt void BrownOut_ISR (void)
{
  
}

/************************************************************************************************************
*    SPI interrupt subroutine
************************************************************************************************************/
#pragma vector=0x4B
__interrupt void SPI_ISR (void)
{
  
}


/************************************************************************************************************
*    Watchdog Timer interrupt subroutine
************************************************************************************************************/
#pragma vector=0x53
__interrupt void WDT_ISR (void)
{
  
}


/************************************************************************************************************
*    ADC interrupt subroutine
************************************************************************************************************/
#pragma vector=0x5B
__interrupt void ADC_ISR (void)
{
  
}


/************************************************************************************************************
*    Input capture interrupt subroutine
************************************************************************************************************/
#pragma vector=0x63
__interrupt void InputCapture_ISR (void)
{
  
}


/************************************************************************************************************
*    PWM interrupt subroutine
************************************************************************************************************/
#pragma vector=0x6B
__interrupt void PWM_ISR (void)
{
  
}


/************************************************************************************************************
*    Fault brake interrupt subroutine
************************************************************************************************************/
#pragma vector=0x73
__interrupt void FaultBrake_ISR(void)
{
  
}

/************************************************************************************************************
*    Seraial port 1 interrupt subroutine
************************************************************************************************************/
#pragma vector=0x7B
__interrupt void UART1_ISR (void)
{
  
}


/************************************************************************************************************
*    Timer 3 interrupt subroutine
************************************************************************************************************/
#pragma vector=0x83
__interrupt void Timer3_ISR (void)
{
  // Interrupt flag was clear by hardware
  Timer_Counter_IncreaseCounter();
}


/************************************************************************************************************
*    Self-wakeup interrupt subroutine
************************************************************************************************************/
#pragma vector=0x8B
__interrupt void SelfWakeup_ISR (void)
{
  
}

/**
  * @}
  */
